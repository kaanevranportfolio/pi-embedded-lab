## yocto-lab/meta-lab/conf/layer.conf
```bitbake
BBPATH .= ":${LAYERDIR}"
BBFILES += "${LAYERDIR}/recipes-*/*/*.bb ${LAYERDIR}/recipes-*/*/*.bbappend"
BBFILE_COLLECTIONS += "lab"
BBFILE_PATTERN_lab = "^${LAYERDIR}/"
BBFILE_PRIORITY_lab = "10"
LAYERDEPENDS_lab = "core"
LAYERSERIES_COMPAT_lab = "scarthgap"
```
